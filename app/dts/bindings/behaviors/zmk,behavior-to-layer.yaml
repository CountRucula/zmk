## app/dts/bindings/behaviors/zmk,behavior-to-layer.yaml
```yaml
# Copyright (c) 2020 The ZMK Contributors
# SPDX-License-Identifier: MIT

description: To Layer

compatible: "zmk,behavior-to-layer"

include: one_param.yaml

properties:
  ignore-layers:
    type: array
    description: Ignore these layers when swiching
    required: false
```
